## ZCL/Kconfig
```kconfig
# ZCL configuration

# Copyright 2024 NXP
# SPDX-License-Identifier: BSD-3-Clause

config MCUX_COMPONENT_middleware.wireless.zigbee.zcl_hf
    bool
    help
      Zigbee module providing include paths for various headers

config MCUX_COMPONENT_middleware.wireless.zigbee.zcl_appliance_mgmt
    bool "Appliance Management Cluster support"
    depends on MCUX_COMPONENT_middleware.wireless.zigbee.features
    help
      Zigbee module providing APIs to handle Appliance Management Cluster support

config MCUX_COMPONENT_middleware.wireless.zigbee.zcl_closures
    bool "Closures Cluster support"
    depends on MCUX_COMPONENT_middleware.wireless.zigbee.features
    help
      Zigbee module providing APIs to handle Closures Cluster support

config MCUX_COMPONENT_middleware.wireless.zigbee.zcl_commissioning
    bool "Commissioning Cluster support"
    depends on MCUX_COMPONENT_middleware.wireless.zigbee.features
    help
      Zigbee module providing APIs to handle Commissioning Cluster support

config MCUX_COMPONENT_middleware.wireless.zigbee.zcl_general
    bool "General Cluster support"
    depends on MCUX_COMPONENT_middleware.wireless.zigbee.coordinator \
        || MCUX_COMPONENT_middleware.wireless.zigbee.enddevice_rx_off \
        || MCUX_COMPONENT_middleware.wireless.zigbee.enddevice_rx_on \
        || MCUX_COMPONENT_middleware.wireless.zigbee.router
    help
      Zigbee module providing APIs to handle General Cluster support

config MCUX_COMPONENT_middleware.wireless.zigbee.zcl_general_pollcontrol
    bool "General Poll Control Cluster support"
    depends on MCUX_COMPONENT_middleware.wireless.zigbee.features
    help
      Zigbee module providing APIs to handle General Poll Control Cluster support

config MCUX_COMPONENT_middleware.wireless.zigbee.zcl_greenpower
    bool "Green Power Cluster support"
    depends on MCUX_COMPONENT_middleware.wireless.zigbee.features
    help
      Zigbee module providing APIs to handle Green Power Cluster support

config MCUX_COMPONENT_middleware.wireless.zigbee.zcl_hvac
    bool "HVAC (Heating, Ventilation, and Air-Conditioning) Cluster support"
    depends on MCUX_COMPONENT_middleware.wireless.zigbee.features
    help
      Zigbee module providing APIs to handle HVAC support Cluster support

config MCUX_COMPONENT_middleware.wireless.zigbee.zcl_lighting
    bool "Lighting Cluster support"
    depends on MCUX_COMPONENT_middleware.wireless.zigbee.features
    help
      Zigbee module providing APIs to handle Lighting Cluster support

config MCUX_COMPONENT_middleware.wireless.zigbee.zcl_measurement_sensing
    bool "Measurement and Sensing Cluster support"
    depends on MCUX_COMPONENT_middleware.wireless.zigbee.features
    help
      Zigbee module providing APIs to handle Measurement and Sensing Cluster support
    
config MCUX_COMPONENT_middleware.wireless.zigbee.zcl_ota_server
    bool "Over-the-Air Server Cluster support"
    depends on MCUX_COMPONENT_middleware.wireless.zigbee.coordinator
    help
      Zigbee module providing APIs to handle Over-the-Air Server Cluster support

config MCUX_COMPONENT_middleware.wireless.zigbee.zcl_ota_client
    bool "Over-the-Air Client Cluster support"
    depends on MCUX_COMPONENT_middleware.wireless.zigbee.enddevice_rx_off \
        || MCUX_COMPONENT_middleware.wireless.zigbee.enddevice_rx_on \
        || MCUX_COMPONENT_middleware.wireless.zigbee.router
    help
      Zigbee module providing APIs to handle Over-the-Air Client Cluster support

config MCUX_COMPONENT_middleware.wireless.zigbee.zcl_security_safety
    bool "Security and Safety Cluster support"
    depends on MCUX_COMPONENT_middleware.wireless.zigbee.features
    help
      Zigbee module providing APIs to handle Security and Safety Cluster support
      
config MCUX_COMPONENT_middleware.wireless.zigbee.zcl_smart_energy
    bool "Smart Energy Cluster support"
    depends on MCUX_COMPONENT_middleware.wireless.zigbee.features
    help
      Zigbee module providing APIs to handle Smart Energy Cluster support

config MCUX_COMPONENT_middleware.wireless.zigbee.device_zgp
    bool "Green Power Device support"
    depends on MCUX_COMPONENT_middleware.wireless.zigbee.features
    help
      Zigbee module providing APIs to handle Green Power Device support

config MCUX_COMPONENT_middleware.wireless.zigbee.device_zha_appliance_mgmt
    bool "Appliance Management Device support"
    depends on MCUX_COMPONENT_middleware.wireless.zigbee.features
    help
      Zigbee module providing APIs to handle Appliance Management Device support

config MCUX_COMPONENT_middleware.wireless.zigbee.device_zha_closures
    bool "Closures Device support"
    depends on MCUX_COMPONENT_middleware.wireless.zigbee.features
    help
      Zigbee module providing APIs to handle Closures Device support
    
config MCUX_COMPONENT_middleware.wireless.zigbee.device_zha_generic
    bool "Home Automation Basic Device support"
    depends on MCUX_COMPONENT_middleware.wireless.zigbee.coordinator \
        || MCUX_COMPONENT_middleware.wireless.zigbee.enddevice_rx_off \
        || MCUX_COMPONENT_middleware.wireless.zigbee.enddevice_rx_on \
        || MCUX_COMPONENT_middleware.wireless.zigbee.router \
        || MCUX_COMPONENT_middleware.wireless.zigbee.coprocessor
    help
      Zigbee module providing APIs to handle Home Automation Basic Device support

config MCUX_COMPONENT_middleware.wireless.zigbee.device_zha_hvac
    bool "Closures Device support"
    depends on MCUX_COMPONENT_middleware.wireless.zigbee.features
    help
      Zigbee module providing APIs to handle Closures Device support
      
config MCUX_COMPONENT_middleware.wireless.zigbee.device_zha_security_safety
    bool "Security and Safety Device support"
    depends on MCUX_COMPONENT_middleware.wireless.zigbee.features
    help
      Zigbee module providing APIs to handle Security and Safety Device support
      
config MCUX_COMPONENT_middleware.wireless.zigbee.device_zha_smart_energy
    bool "Smart Energy Device support"
    depends on MCUX_COMPONENT_middleware.wireless.zigbee.features
    help
      Zigbee module providing APIs to handle Smart Energy Device support
      
config MCUX_COMPONENT_middleware.wireless.zigbee.device_zlo
    bool "Lighting and Occupancy Device support"
    depends on MCUX_COMPONENT_middleware.wireless.zigbee.features
    help
      Zigbee module providing APIs to handle Lighting and Occupancy Device
```

## ZigbeeCommon/Kconfig
```kconfig
# ZigbeeCommon configuration

# Copyright 2024 NXP
# SPDX-License-Identifier: BSD-3-Clause

config MCUX_COMPONENT_middleware.wireless.zigbee.core_common
    bool
    depends on MCUX_COMPONENT_middleware.wireless.zigbee.coordinator \
        || MCUX_COMPONENT_middleware.wireless.zigbee.enddevice_rx_off \
        || MCUX_COMPONENT_middleware.wireless.zigbee.enddevice_rx_on \
        || MCUX_COMPONENT_middleware.wireless.zigbee.router \
        || MCUX_COMPONENT_middleware.wireless.zigbee.coprocessor
```

## examples/Kconfig
```kconfig
# examples configuration

# Copyright 2024 NXP
# SPDX-License-Identifier: BSD-3-Clause

config MCUX_COMPONENT_middleware.wireless.zigbee.examples_common
    bool
    select MCUX_COMPONENT_middleware.wireless.zigbee.freertos_common if  MCUX_COMPONENT_middleware.freertos-kernel
    select MCUX_COMPONENT_middleware.freertos-kernel.extension if MCUX_COMPONENT_middleware.freertos-kernel
    depends on MCUX_COMPONENT_middleware.wireless.zigbee.coordinator \
        || MCUX_COMPONENT_middleware.wireless.zigbee.enddevice_rx_off \
        || MCUX_COMPONENT_middleware.wireless.zigbee.enddevice_rx_on \
        || MCUX_COMPONENT_middleware.wireless.zigbee.router \
        || MCUX_COMPONENT_middleware.wireless.zigbee.coprocessor

config MCUX_COMPONENT_middleware.wireless.zigbee.examples_common_ota_client
    bool
    depends on MCUX_COMPONENT_middleware.wireless.zigbee.enddevice_rx_off \
        || MCUX_COMPONENT_middleware.wireless.zigbee.enddevice_rx_on \
        || MCUX_COMPONENT_middleware.wireless.zigbee.router

config MCUX_COMPONENT_middleware.wireless.zigbee.examples_common_ota_server
    bool
    depends on MCUX_COMPONENT_middleware.wireless.zigbee.coordinator 

config MCUX_COMPONENT_middleware.wireless.zigbee.serial_link_wkr
    bool "Coprocessor Serial Link support"
    depends on MCUX_COMPONENT_middleware.wireless.zigbee.coprocessor

config MCUX_COMPONENT_middleware.wireless.zigbee.freertos_common
    bool
    depends on MCUX_COMPONENT_middleware.freertos-kernel

config MCUX_COMPONENT_middleware.wireless.zigbee.ncp_host
    bool "NCP HOST support"
    depends on CONFIG_MCUX_COMPONENT_middleware.wireless.zigbee.platform_ncp_host

config MCUX_COMPONENT_middleware.wireless.zigbee.ncp_host_examples
    depends on CONFIG_MCUX_COMPONENT_middleware.wireless.zigbee.ncp_host
    bool

config MCUX_COMPONENT_middleware.wireless.zigbee.ncp_host_examples_collaterals
    depends on CONFIG_MCUX_COMPONENT_middleware.wireless.zigbee.ncp_host
    bool
```

## platform/Kconfig
```kconfig
# platform configuration

# Copyright 2024 NXP
# SPDX-License-Identifier: BSD-3-Clause

menuconfig MCUX_COMPONENT_middleware.wireless.zigbee.platform
    bool "Zigbee Connectivity platform"
    default MCUX_COMPONENT_middleware.wireless.framework.platform
    depends on MCUX_HW_DEVICE_MCXW716C || MCUX_HW_DEVICE_MCXW716A \
        || MCUX_HW_DEVICE_KW45B41Z52 || MCUX_HW_DEVICE_KW45B41Z53 \
        || MCUX_HW_DEVICE_KW45B41Z82 || MCUX_HW_DEVICE_KW45B41Z83 \
        || MCUX_HW_DEVICE_K32W1480 \
        || MCUX_HW_DEVICE_RW612 || MCUX_HW_DEVICE_RW610 \
        || MCUX_HW_DEVICE_KW47B42ZB7 || MCUX_HW_DEVICE_MCXW727C

if MCUX_COMPONENT_middleware.wireless.zigbee.platform

choice
    prompt "Connectivity platform selection"

config MCUX_COMPONENT_middleware.wireless.zigbee.platform.kw45_k32w1_mcxw71
    bool "KW45x, K32W1x, MCXW71x families"
    depends on  MCUX_HW_DEVICE_MCXW716C || MCUX_HW_DEVICE_MCXW716A ||       \
                MCUX_HW_DEVICE_KW45B41Z52 || MCUX_HW_DEVICE_KW45B41Z53 ||   \
                MCUX_HW_DEVICE_KW45B41Z82 || MCUX_HW_DEVICE_KW45B41Z83  ||  \
                MCUX_HW_DEVICE_K32W1480
    help
        Zigbee platform specific file for KW45x, K32W1x, MCXW71x families

config MCUX_COMPONENT_middleware.wireless.zigbee.platform.kw47_mcxw72
    bool "KW47x, MCXW72x families"
    depends on MCUX_HW_DEVICE_KW47B42ZB7 || MCUX_HW_DEVICE_MCXW727C
    help
        Zigbee platform specific file for KW47x, MCXW72x families

config MCUX_COMPONENT_middleware.wireless.zigbee.platform.rw61x
    bool "RW61x platform"
    select MCUX_COMPONENT_middleware.wireless.framework.platform.zb
    select MCUX_COMPONENT_middleware.wireless.framework.rng
    select MCUX_COMPONENT_middleware.wireless.framework.seclib
    select MCUX_COMPONENT_middleware.wireless.framework.pdm
    select MCUX_COMPONENT_middleware.wireless.framework.pdum
    select MCUX_COMPONENT_middleware.wireless.framework.lowpower
    select MCUX_COMPONENT_component.button
    select MCUX_COMPONENT_component.led
    select MCUX_COMPONENT_component.timer_manager
    select MCUX_COMPONENT_component.power_manager_framework
    select MCUX_COMPONENT_component.osa
    select NVS
    select NVS_LOOKUP_CACHE
    select gPlatformMonolithicApp_d
    depends on MCUX_HW_DEVICE_RW612 || MCUX_HW_DEVICE_RW610
    help
        Zigbee platform specific file for RW61x families

endchoice
endif

config MCUX_COMPONENT_middleware.wireless.zigbee.platform.core_libs
    bool
    depends on MCUX_COMPONENT_middleware.wireless.zigbee.platform.kw45_k32w1_mcxw71 || \
            MCUX_COMPONENT_middleware.wireless.framework.platform.kw47_mcxw72 || \
            MCUX_COMPONENT_middleware.wireless.zigbee.platform.rw61x

config MCUX_COMPONENT_middleware.wireless.zigbee.platform.core_libs_r23
    bool
    depends on MCUX_COMPONENT_middleware.wireless.zigbee.platform.kw45_k32w1_mcxw71 || \
            MCUX_COMPONENT_middleware.wireless.framework.platform.kw47_mcxw72 || \
            MCUX_COMPONENT_middleware.wireless.zigbee.platform.rw61x

config MCUX_COMPONENT_middleware.wireless.zigbee.platform.zed_libs
    bool
    depends on MCUX_COMPONENT_middleware.wireless.zigbee.platform.kw45_k32w1_mcxw71 || \
            MCUX_COMPONENT_middleware.wireless.framework.platform.kw47_mcxw72 || \
            MCUX_COMPONENT_middleware.wireless.zigbee.platform.rw61x

config MCUX_COMPONENT_middleware.wireless.zigbee.platform.zed_libs_r23
    bool
    depends on MCUX_COMPONENT_middleware.wireless.zigbee.platform.kw45_k32w1_mcxw71 || \
            MCUX_COMPONENT_middleware.wireless.framework.platform.kw47_mcxw72 || \
            MCUX_COMPONENT_middleware.wireless.zigbee.platform.rw61x
```
